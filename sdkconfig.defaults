## sdkconfig.defaults
```kconfig
# OTA HTTPS - Mozilla Certificate Bundle
CONFIG_MBEDTLS_CERTIFICATE_BUNDLE=y
CONFIG_MBEDTLS_CERTIFICATE_BUNDLE_DEFAULT_FULL=y

# Partition Table
CONFIG_PARTITION_TABLE_CUSTOM=y
CONFIG_PARTITION_TABLE_CUSTOM_FILENAME="partitions.csv"

# OTA Rollback
CONFIG_BOOTLOADER_APP_ROLLBACK_ENABLE=y

# HTTPS
CONFIG_ESP_HTTP_CLIENT_ENABLE_HTTPS=y

# Memory
CONFIG_MBEDTLS_SSL_MAX_CONTENT_LEN=16384
CONFIG_MBEDTLS_ASYMMETRIC_CONTENT_LEN=y
```
